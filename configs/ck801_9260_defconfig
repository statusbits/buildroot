## configs/ck801_9260_defconfig
```kconfig
BR2_arm=y
BR2_arm926t=y
# BR2_PRIMARY_SITE="http://support.ctekproducts.com/source"
BR2_TOOLCHAIN_EXTERNAL=y
BR2_TARGET_GENERIC_HOSTNAME="G6200"
BR2_TARGET_GENERIC_ISSUE="CTEK G6200"
BR2_ROOTFS_DEVICE_CREATION_DYNAMIC_UDEV=y
BR2_ROOTFS_SKELETON_CUSTOM=y
BR2_ROOTFS_SKELETON_CUSTOM_PATH="local/ck801-skeleton"
BR2_PACKAGE_BUSYBOX_CONFIG="local/ck801_9260/busybox-1.20.x.config"
BR2_PACKAGE_BUSYBOX_WATCHDOG=y
BR2_PACKAGE_BZIP2=y
BR2_PACKAGE_E2FSPROGS=y
BR2_PACKAGE_MTD=y
BR2_PACKAGE_MTD_FTL_CHECK=y
BR2_PACKAGE_MTD_FTL_FORMAT=y
BR2_PACKAGE_MTD_JFFS2DUMP=y
BR2_PACKAGE_MTD_SUMTOOL=y
# BR2_PACKAGE_MTD_UBIATTACH is not set
# BR2_PACKAGE_MTD_UBICRC32 is not set
# BR2_PACKAGE_MTD_UBIDETACH is not set
# BR2_PACKAGE_MTD_UBIFORMAT is not set
# BR2_PACKAGE_MTD_UBIMKVOL is not set
# BR2_PACKAGE_MTD_UBINFO is not set
# BR2_PACKAGE_MTD_UBINIZE is not set
# BR2_PACKAGE_MTD_UBIRENAME is not set
# BR2_PACKAGE_MTD_UBIRMVOL is not set
# BR2_PACKAGE_MTD_UBIRSVOL is not set
# BR2_PACKAGE_MTD_UBIUPDATEVOL is not set
BR2_PACKAGE_UBOOT_TOOLS=y
BR2_PACKAGE_USBMOUNT=y
BR2_PACKAGE_USBUTILS=y
BR2_PACKAGE_USBUTILS_ZLIB=y
BR2_PACKAGE_LZO=y
BR2_PACKAGE_LIBGCRYPT=y
BR2_PACKAGE_OPENSSL_BIN=y
BR2_PACKAGE_OPENSSL_ENGINES=y
BR2_PACKAGE_LIBCONFUSE=y
BR2_PACKAGE_LIBFTDI=y
BR2_PACKAGE_LIBCURL=y
BR2_PACKAGE_CURL=y
BR2_PACKAGE_LIBIDN=y
BR2_PACKAGE_PCRE=y
BR2_PACKAGE_READLINE=y
BR2_CTEK_SAMPLES=y
BR2_PACKAGE_BOA=y
BR2_PACKAGE_ETHTOOL=y
BR2_PACKAGE_IPSEC_TOOLS=y
BR2_PACKAGE_IPSEC_TOOLS_DPD=y
BR2_PACKAGE_IPTABLES=y
BR2_PACKAGE_LINKS=y
BR2_PACKAGE_NCFTP=y
# BR2_PACKAGE_NCFTP_PUT is not set
# BR2_PACKAGE_NCFTP_LS is not set
# BR2_PACKAGE_NCFTP_BATCH is not set
BR2_PACKAGE_NTP=y
# BR2_PACKAGE_NTP_NTPD is not set
BR2_PACKAGE_NTP_NTPDATE=y
BR2_PACKAGE_OPENSSH=y
BR2_PACKAGE_PPPD=y
BR2_PACKAGE_STUNNEL=y
BR2_PACKAGE_TELNETD=y
BR2_PACKAGE_VFTPD=y
BR2_PACKAGE_LOGROTATE=y
BR2_PACKAGE_RESPAWND=y
BR2_TARGET_ROOTFS_JFFS2=y
BR2_TARGET_ROOTFS_JFFS2_CUSTOM=y
BR2_TARGET_ROOTFS_JFFS2_CUSTOM_PAGESIZE=0x800
BR2_TARGET_ROOTFS_JFFS2_SUMMARY=y
BR2_TARGET_ROOTFS_TAR_GZIP=y
BR2_TARGET_UBOOT=y
BR2_TARGET_UBOOT_BOARDNAME="at91sam9260ek_dataflash_cs1"
BR2_TARGET_UBOOT_CUSTOM_PATCH_DIR="local/ck801_9260/u-boot-patches"
BR2_LINUX_KERNEL=y
BR2_LINUX_KERNEL_CUSTOM_VERSION=y
BR2_LINUX_KERNEL_CUSTOM_VERSION_VALUE="3.4.19"
BR2_LINUX_KERNEL_PATCH="local/ck801_9260/kernel-patches"
BR2_LINUX_KERNEL_USE_CUSTOM_CONFIG=y
BR2_LINUX_KERNEL_CUSTOM_CONFIG_FILE="local/ck801_9260/linux-3.4-config"
```

## package/cteksamples/Config.in
```kconfig
config BR2_CTEK_SAMPLES
	bool "cteksamples"
	help
	  Sample test code for gpio, voltage, etc.

	  http://www.ctekproducts.com
```

## package/libfdipc/Config.in
```kconfig
config BR2_PACKAGE_LIBFDIPC
	bool "libfdipc"
	help
	  Library implements transfer of open file descriptors by AF_UNIX datagram sockets.
```

## package/respawnd/Config.in
```kconfig
config BR2_PACKAGE_RESPAWND
	bool "respawnd"
	help
	  This the respawn daemon developed by Axis Communications.
```

## package/telnetd-init/Config.in
```kconfig
config BR2_PACKAGE_TELNETD
	bool "telnetdinit"
	help
	  This the startup script and configuration for busybox telnetd
```

## package/vftpd/Config.in
```kconfig
config BR2_PACKAGE_VFTPD
	bool "vftpd"
	help
	  This is the vftp server used in the Axis Communications distribution.
```
